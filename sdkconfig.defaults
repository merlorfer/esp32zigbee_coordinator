## sdkconfig.defaults
```kconfig
# ESP32-C6 Zigbee Gateway - SDK Configuration Defaults

# Target
CONFIG_IDF_TARGET="esp32c6"

#
# Partition Table
#
CONFIG_PARTITION_TABLE_CUSTOM=y
CONFIG_PARTITION_TABLE_CUSTOM_FILENAME="partitions.csv"
CONFIG_PARTITION_TABLE_FILENAME="partitions.csv"
CONFIG_PARTITION_TABLE_OFFSET=0x8000
CONFIG_PARTITION_TABLE_MD5=y
# end of Partition Table

# Flash Size
CONFIG_ESPTOOLPY_FLASHSIZE_4MB=y

#
# mbedTLS
#
CONFIG_MBEDTLS_HARDWARE_AES=n
CONFIG_MBEDTLS_HARDWARE_MPI=n
CONFIG_MBEDTLS_HARDWARE_SHA=n
CONFIG_MBEDTLS_CMAC_C=y
CONFIG_MBEDTLS_SSL_PROTO_DTLS=y
CONFIG_MBEDTLS_KEY_EXCHANGE_ECJPAKE=y
# end of TLS Key Exchange Methods

CONFIG_MBEDTLS_ECJPAKE_C=y
# end of mbedTLS

#
# Zboss
#
CONFIG_ZB_ENABLED=y
CONFIG_ZB_ZCZR=y
# end of Zboss
# end of Component config

# Wi-Fi Configuration
CONFIG_ESP_WIFI_SOFTAP_SUPPORT=y

# SPIFFS Configuration
CONFIG_SPIFFS_MAX_PARTITIONS=1

# FreeRTOS
CONFIG_FREERTOS_HZ=1000
CONFIG_FREERTOS_TIMER_TASK_STACK_DEPTH=3072

# Log Level
CONFIG_LOG_DEFAULT_LEVEL_INFO=y
CONFIG_LOG_MAXIMUM_LEVEL_DEBUG=y

# Stack Sizes
CONFIG_ESP_MAIN_TASK_STACK_SIZE=4096
CONFIG_ESP_SYSTEM_EVENT_TASK_STACK_SIZE=3072

# LWIP
CONFIG_LWIP_MAX_SOCKETS=10
CONFIG_LWIP_SO_RCVBUF=y

# HTTP Server
CONFIG_HTTPD_MAX_REQ_HDR_LEN=1024
CONFIG_HTTPD_MAX_URI_LEN=512

# Compiler Optimization
CONFIG_COMPILER_OPTIMIZATION_SIZE=y

# Newlib - nano formatting
CONFIG_LIBC_NEWLIB_NANO_FORMAT=y
```

## xkc_level_sensor/sdkconfig.defaults
```kconfig
# XKC Water Level Sensor - Zigbee End Device
# SDK Configuration Defaults

# Target
CONFIG_IDF_TARGET="esp32c6"

# Flash Size
CONFIG_ESPTOOLPY_FLASHSIZE_4MB=y

# USB Serial JTAG Console
CONFIG_ESP_CONSOLE_USB_SERIAL_JTAG=y

# mbedTLS
CONFIG_MBEDTLS_HARDWARE_AES=n
CONFIG_MBEDTLS_HARDWARE_MPI=n
CONFIG_MBEDTLS_HARDWARE_SHA=n
CONFIG_MBEDTLS_CMAC_C=y
CONFIG_MBEDTLS_SSL_PROTO_DTLS=y
CONFIG_MBEDTLS_KEY_EXCHANGE_ECJPAKE=y
CONFIG_MBEDTLS_ECJPAKE_C=y

# Zboss - End Device
CONFIG_ZB_ENABLED=y
CONFIG_ZB_ZED=y

# FreeRTOS
CONFIG_FREERTOS_HZ=1000

# Log Level
CONFIG_LOG_DEFAULT_LEVEL_INFO=y
CONFIG_LOG_MAXIMUM_LEVEL_DEBUG=y

# Stack Sizes
CONFIG_ESP_MAIN_TASK_STACK_SIZE=4096

# Compiler Optimization
CONFIG_COMPILER_OPTIMIZATION_SIZE=y
```
